## dist/buildroot/package/apple-bce/Config.in
```kconfig
config BR2_PACKAGE_APPLE_BCE
	bool "apple-bce"
	depends on BR2_LINUX_KERNEL
	depends on BR2_x86_64
	help
	  The t2linux apple-bce kernel module for Intel Macs with the
	  Apple T2 chip (Mac mini 2018, MacBook Pro/Air 2018-2020,
	  iMac 2020, iMac Pro, Mac Pro 2019): the T2's internal USB
	  devices (VHCI) and its sound card "Apple T2 Audio" (built-in
	  speaker, headphone jack). Selected by the IYAKKI "mac" variant
	  only (configs/iyakki_mac.fragment). Out of tree, GPL-2.0,
	  built against the image's own kernel.

	  https://github.com/t2linux/apple-bce-drv

comment "apple-bce needs a Linux kernel to be built (x86_64)"
	depends on BR2_x86_64
	depends on !BR2_LINUX_KERNEL
```

## dist/buildroot/package/facetimehd/Config.in
```kconfig
config BR2_PACKAGE_FACETIMEHD
	bool "facetimehd"
	depends on BR2_LINUX_KERNEL
	depends on BR2_x86_64
	help
	  Camera driver for the Broadcom 720p FaceTime HD camera
	  (PCI 14e4:1570) of MacBooks without the T2 chip, such as the
	  MacBookPro13,x/14,x. This is patjak's facetimehd, built out of
	  tree as facetimehd.ko together with the kernel's own
	  videobuf2-dma-sg.ko (copied from the kernel tree). The camera
	  needs Apple's firmware, which is never shipped: the person
	  downloads it on their own machine (IYAKKI Setup, "Camera
	  firmware"). The module is loaded by its PCI alias. GPL-2.0.
	  Selected by the IYAKKI "mac" variant only
	  (configs/iyakki_mac.fragment).

	  https://github.com/patjak/facetimehd

comment "facetimehd needs a Linux kernel to be built (x86_64)"
	depends on BR2_x86_64
	depends on !BR2_LINUX_KERNEL
```

## dist/buildroot/package/iyakki-git-ssh/Config.in
```kconfig
config BR2_PACKAGE_IYAKKI_GIT_SSH
	bool "iyakki-git-ssh"
	depends on BR2_USE_MMU
	select BR2_PACKAGE_OPENSSL
	select BR2_PACKAGE_ZLIB
	help
	  The OpenSSH `ssh` client program ONLY (BSD/ISC licence), installed
	  as /usr/libexec/iyakki/git-ssh and used by git through
	  GIT_SSH_COMMAND, because it speaks the ssh-agent protocol and
	  Dropbear's dbclient does not. Not on the PATH: the CLI tile keeps
	  using Dropbear's `ssh`. docs/GIT-AND-SSH.md
```

## dist/buildroot/package/iyakki-webview-helper/Config.in
```kconfig
config BR2_PACKAGE_IYAKKI_WEBVIEW_HELPER
	bool "iyakki-webview-helper"
	depends on BR2_PACKAGE_WPEWEBKIT
	depends on BR2_PACKAGE_WPEBACKEND_FDO
	depends on BR2_PACKAGE_WAYLAND
	help
	  The web engine helper of the IYAKKI "web" image variant: WPE
	  WebKit rendered offscreen (libwpe + WPEBackend-fdo, shared memory
	  pictures) and driven by the IYAKKI shell over the protocol of
	  docs/WEBVIEW-PROTOCOL.md. Installed as
	  /usr/libexec/iyakki/webview-helper.

	  Source: dist/webview/wpe-helper of this repository.
```

## dist/buildroot/package/nvidia-open/Config.in
```kconfig
config BR2_PACKAGE_NVIDIA_OPEN
	bool "nvidia-open"
	depends on BR2_LINUX_KERNEL
	depends on BR2_x86_64
	help
	  NVIDIA's open GPU kernel modules (nvidia.ko, nvidia-uvm.ko,
	  nvidia-modeset.ko, nvidia-drm.ko) for Turing and newer GPUs
	  (GTX 16xx, RTX 20/30/40/50 series), built out of tree
	  against the image's own kernel. Dual licence MIT / GPL-2.0.
	  The matching user-space libraries and the GSP firmware are
	  NOT part of this package and not part of any image: the
	  installer downloads them from NVIDIA at the person's click
	  (docs/GPU-K3S.md). Off in every image unless the fragment
	  configs/iyakki_nvidia_open.fragment is appended.

	  https://github.com/NVIDIA/open-gpu-kernel-modules

comment "nvidia-open needs a Linux kernel to be built (x86_64)"
	depends on BR2_x86_64
	depends on !BR2_LINUX_KERNEL
```

## dist/buildroot/package/snd-hda-macbookpro/Config.in
```kconfig
config BR2_PACKAGE_SND_HDA_MACBOOKPRO
	bool "snd-hda-macbookpro"
	depends on BR2_LINUX_KERNEL
	depends on BR2_x86_64
	help
	  Sound output for Macs whose HD-audio codec is the Cirrus Logic
	  CS8409 with Apple's amplifiers: MacBookPro13,x and 14,x (2016
	  and 2017, no T2 chip) and the 2017-2019 iMacs. The kernel
	  binds its generic codec driver to that codec, which has no
	  volume or switch controls, so the speakers stay silent. This is
	  David Odin's snd_hda_macbookpro: the kernel's own patch_cs8409
	  with Apple's setup patched in, built out of tree as
	  snd-hda-codec-cs8409.ko and picked by the codec's vendor id.
	  Speaker and headphone output; the microphone does not work.
	  Selected by the IYAKKI "mac" variant only
	  (configs/iyakki_mac.fragment). GPL-2.0.

	  https://github.com/davidjo/snd_hda_macbookpro

comment "snd-hda-macbookpro needs a Linux kernel to be built (x86_64)"
	depends on BR2_x86_64
	depends on !BR2_LINUX_KERNEL
```
